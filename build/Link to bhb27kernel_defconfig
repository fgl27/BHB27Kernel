## drivers/soc/qcom/hotplug/Kconfig
```kconfig
if ARCH_MSM

config BLU_PLUG
 	bool "Dynamic hotplug driver"
 	depends on HOTPLUG_CPU
 	help
	  The Dynamic hotplug driver automatically online/offline CPUs proportional to system load.

config MSM_HOTPLUG
	bool "MSM hotplug driver"
	depends on HOTPLUG_CPU
	default y
	help
	  The MSM hotplug driver controls on-/offlining of additional cores based
	  on current cpu load.


config BRICKED_HOTPLUG
	bool "Enable kernel based mpdecision"
	depends on MSM_RUN_QUEUE_STATS
	default y
	help
	  This enables kernel based multi core control.
	  (up/down hotplug based on load)


config INTELLI_HOTPLUG
	bool "Intelli hotplug driver"
	depends on HOTPLUG_CPU
	default y
	help
	  An intelligent cpu hotplug driver for
	  Low Latency Frequency Transition capable processors.

config AUTOSMP
	bool "Multi-core automatic hotplug support"
	depends on SMP && HOTPLUG_CPU
	help
	  Automatically hotplugs the multiple cpu cores on and off
	  based on cpu load and suspend state

endif # ARCH_MSM
```
